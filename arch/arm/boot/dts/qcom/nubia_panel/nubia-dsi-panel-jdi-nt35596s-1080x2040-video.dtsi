/* Copyright (c) 2013, The Linux Foundation. All rights reserved.
 *
 * This program is free software; you can redistribute it and/or modify
 * it under the terms of the GNU General Public License version 2 and
 * only version 2 as published by the Free Software Foundation.
 *
 * This program is distributed in the hope that it will be useful,
 * but WITHOUT ANY WARRANTY; without even the implied warranty of
 * MERCHANTABILITY or FITNESS FOR A PARTICULAR PURPOSE.  See the
 * GNU General Public License for more details.
 */

/*---------------------------------------------------------------------------
 * This file is autogenerated file using gcdb parser. Please do not edit it.
 * Update input XML file to add a new entry or update variable in this file
 * VERSION = "1.0"
 *---------------------------------------------------------------------------*/
&mdss_mdp {
		jdi_dsi_nt35596s_1080x2040_video: qcom,mdss_dsi_jdi_nt35596s_1080x2040_video {
		qcom,mdss-dsi-panel-name = "jdi nt35596s 1080x2040 mipi video panel";
		qcom,mdss-dsi-panel-controller = <&mdss_dsi0>;
		qcom,mdss-dsi-panel-type = "dsi_video_mode";
		qcom,mdss-dsi-panel-framerate = <60>;
		qcom,mdss-dsi-virtual-channel-id = <0>;
		qcom,mdss-dsi-stream = <0>;
		qcom,mdss-dsi-panel-width = <1080>;
		qcom,mdss-dsi-panel-height = <2040>;
		qcom,mdss-dsi-h-front-porch = <12>;
		qcom,mdss-dsi-h-back-porch = <64>;
		qcom,mdss-dsi-h-pulse-width = <4>;
		qcom,mdss-dsi-h-sync-skew = <0>;
		qcom,mdss-dsi-v-back-porch = <23>;
		qcom,mdss-dsi-v-front-porch = <4>;
		qcom,mdss-dsi-v-pulse-width = <1>;
		qcom,mdss-dsi-h-left-border = <0>;
		qcom,mdss-dsi-h-right-border = <0>;
		qcom,mdss-dsi-v-top-border = <0>;
		qcom,mdss-dsi-v-bottom-border = <0>;
		qcom,mdss-dsi-bpp = <24>;
		qcom,mdss-dsi-underflow-color = <0xff>;
		qcom,mdss-dsi-border-color = <0>;
		qcom,mdss-dsi-on-command = [
				15 01 00 00 00 00 02 FF 20
				15 01 00 00 00 00 02 FB 01
				15 01 00 00 00 00 02 75 01
				15 01 00 00 00 00 02 76 2A
				15 01 00 00 00 00 02 77 01
				15 01 00 00 00 00 02 78 2F
				15 01 00 00 00 00 02 79 01
				15 01 00 00 00 00 02 7A 3A
				15 01 00 00 00 00 02 7B 01
				15 01 00 00 00 00 02 7C 44
				15 01 00 00 00 00 02 7D 01
				15 01 00 00 00 00 02 7E 4D
				15 01 00 00 00 00 02 7F 01
				15 01 00 00 00 00 02 80 56
				15 01 00 00 00 00 02 81 01
				15 01 00 00 00 00 02 82 5D
				15 01 00 00 00 00 02 83 01
				15 01 00 00 00 00 02 84 66
				15 01 00 00 00 00 02 85 01
				15 01 00 00 00 00 02 86 6E
				15 01 00 00 00 00 02 87 01
				15 01 00 00 00 00 02 88 88
				15 01 00 00 00 00 02 89 01
				15 01 00 00 00 00 02 8A A1
				15 01 00 00 00 00 02 8B 01
				15 01 00 00 00 00 02 8C C9
				15 01 00 00 00 00 02 8D 01
				15 01 00 00 00 00 02 8E EC
				15 01 00 00 00 00 02 8F 02
				15 01 00 00 00 00 02 90 25
				15 01 00 00 00 00 02 91 02
				15 01 00 00 00 00 02 92 53
				15 01 00 00 00 00 02 93 02
				15 01 00 00 00 00 02 94 55
				15 01 00 00 00 00 02 95 02
				15 01 00 00 00 00 02 96 86
				15 01 00 00 00 00 02 97 02
				15 01 00 00 00 00 02 98 BF
				15 01 00 00 00 00 02 99 02
				15 01 00 00 00 00 02 9A E5
				15 01 00 00 00 00 02 9B 03
				15 01 00 00 00 00 02 9C 16
				15 01 00 00 00 00 02 9D 03
				15 01 00 00 00 00 02 9E 34
				15 01 00 00 00 00 02 9F 03
				15 01 00 00 00 00 02 A0 5B
				15 01 00 00 00 00 02 A2 03
				15 01 00 00 00 00 02 A3 68
				15 01 00 00 00 00 02 A4 03
				15 01 00 00 00 00 02 A5 75
				15 01 00 00 00 00 02 A6 03
				15 01 00 00 00 00 02 A7 85
				15 01 00 00 00 00 02 A9 03
				15 01 00 00 00 00 02 AA 97
				15 01 00 00 00 00 02 AB 03
				15 01 00 00 00 00 02 AC AC
				15 01 00 00 00 00 02 AD 03
				15 01 00 00 00 00 02 AE C3
				15 01 00 00 00 00 02 AF 03
				15 01 00 00 00 00 02 B0 CE
				15 01 00 00 00 00 02 B1 03
				15 01 00 00 00 00 02 B2 FF
				15 01 00 00 00 00 02 B3 01
				15 01 00 00 00 00 02 B4 2A
				15 01 00 00 00 00 02 B5 01
				15 01 00 00 00 00 02 B6 2F
				15 01 00 00 00 00 02 B7 01
				15 01 00 00 00 00 02 B8 3A
				15 01 00 00 00 00 02 B9 01
				15 01 00 00 00 00 02 BA 44
				15 01 00 00 00 00 02 BB 01
				15 01 00 00 00 00 02 BC 4D
				15 01 00 00 00 00 02 BD 01
				15 01 00 00 00 00 02 BE 56
				15 01 00 00 00 00 02 BF 01
				15 01 00 00 00 00 02 C0 5D
				15 01 00 00 00 00 02 C1 01
				15 01 00 00 00 00 02 C2 66
				15 01 00 00 00 00 02 C3 01
				15 01 00 00 00 00 02 C4 6E
				15 01 00 00 00 00 02 C5 01
				15 01 00 00 00 00 02 C6 88
				15 01 00 00 00 00 02 C7 01
				15 01 00 00 00 00 02 C8 A1
				15 01 00 00 00 00 02 C9 01
				15 01 00 00 00 00 02 CA C9
				15 01 00 00 00 00 02 CB 01
				15 01 00 00 00 00 02 CC EC
				15 01 00 00 00 00 02 CD 02
				15 01 00 00 00 00 02 CE 25
				15 01 00 00 00 00 02 CF 02
				15 01 00 00 00 00 02 D0 53
				15 01 00 00 00 00 02 D1 02
				15 01 00 00 00 00 02 D2 55
				15 01 00 00 00 00 02 D3 02
				15 01 00 00 00 00 02 D4 86
				15 01 00 00 00 00 02 D5 02
				15 01 00 00 00 00 02 D6 BF
				15 01 00 00 00 00 02 D7 02
				15 01 00 00 00 00 02 D8 E5
				15 01 00 00 00 00 02 D9 03
				15 01 00 00 00 00 02 DA 16
				15 01 00 00 00 00 02 DB 03
				15 01 00 00 00 00 02 DC 34
				15 01 00 00 00 00 02 DD 03
				15 01 00 00 00 00 02 DE 5B
				15 01 00 00 00 00 02 DF 03
				15 01 00 00 00 00 02 E0 68
				15 01 00 00 00 00 02 E1 03
				15 01 00 00 00 00 02 E2 75
				15 01 00 00 00 00 02 E3 03
				15 01 00 00 00 00 02 E4 85
				15 01 00 00 00 00 02 E5 03
				15 01 00 00 00 00 02 E6 97
				15 01 00 00 00 00 02 E7 03
				15 01 00 00 00 00 02 E8 AC
				15 01 00 00 00 00 02 E9 03
				15 01 00 00 00 00 02 EA C3
				15 01 00 00 00 00 02 EB 03
				15 01 00 00 00 00 02 EC CE
				15 01 00 00 00 00 02 ED 03
				15 01 00 00 00 00 02 EE FF
				15 01 00 00 00 00 02 EF 00
				15 01 00 00 00 00 02 F0 B1
				15 01 00 00 00 00 02 F1 00
				15 01 00 00 00 00 02 F2 BE
				15 01 00 00 00 00 02 F3 00
				15 01 00 00 00 00 02 F4 D5
				15 01 00 00 00 00 02 F5 00
				15 01 00 00 00 00 02 F6 E9
				15 01 00 00 00 00 02 F7 00
				15 01 00 00 00 00 02 F8 FB
				15 01 00 00 00 00 02 F9 01
				15 01 00 00 00 00 02 FA 0B
				15 01 00 00 00 00 02 FF 21
				15 01 00 00 00 00 02 FB 01
				15 01 00 00 00 00 02 00 01
				15 01 00 00 00 00 02 01 1A
				15 01 00 00 00 00 02 02 01
				15 01 00 00 00 00 02 03 27
				15 01 00 00 00 00 02 04 01
				15 01 00 00 00 00 02 05 33
				15 01 00 00 00 00 02 06 01
				15 01 00 00 00 00 02 07 5D
				15 01 00 00 00 00 02 08 01
				15 01 00 00 00 00 02 09 7E
				15 01 00 00 00 00 02 0A 01
				15 01 00 00 00 00 02 0B B2
				15 01 00 00 00 00 02 0C 01
				15 01 00 00 00 00 02 0D DA
				15 01 00 00 00 00 02 0E 02
				15 01 00 00 00 00 02 0F 1B
				15 01 00 00 00 00 02 10 02
				15 01 00 00 00 00 02 11 4D
				15 01 00 00 00 00 02 12 02
				15 01 00 00 00 00 02 13 4F
				15 01 00 00 00 00 02 14 02
				15 01 00 00 00 00 02 15 81
				15 01 00 00 00 00 02 16 02
				15 01 00 00 00 00 02 17 B9
				15 01 00 00 00 00 02 18 02
				15 01 00 00 00 00 02 19 DF
				15 01 00 00 00 00 02 1A 03
				15 01 00 00 00 00 02 1B 11
				15 01 00 00 00 00 02 1C 03
				15 01 00 00 00 00 02 1D 2F
				15 01 00 00 00 00 02 1E 03
				15 01 00 00 00 00 02 1F 56
				15 01 00 00 00 00 02 20 03
				15 01 00 00 00 00 02 21 62
				15 01 00 00 00 00 02 22 03
				15 01 00 00 00 00 02 23 6F
				15 01 00 00 00 00 02 24 03
				15 01 00 00 00 00 02 25 7E
				15 01 00 00 00 00 02 26 03
				15 01 00 00 00 00 02 27 90
				15 01 00 00 00 00 02 28 03
				15 01 00 00 00 00 02 29 A4
				15 01 00 00 00 00 02 2A 03
				15 01 00 00 00 00 02 2B BB
				15 01 00 00 00 00 02 2D 03
				15 01 00 00 00 00 02 2F CA
				15 01 00 00 00 00 02 30 03
				15 01 00 00 00 00 02 31 FF
				15 01 00 00 00 00 02 32 00
				15 01 00 00 00 00 02 33 B1
				15 01 00 00 00 00 02 34 00
				15 01 00 00 00 00 02 35 BE
				15 01 00 00 00 00 02 36 00
				15 01 00 00 00 00 02 37 D5
				15 01 00 00 00 00 02 38 00
				15 01 00 00 00 00 02 39 E9
				15 01 00 00 00 00 02 3A 00
				15 01 00 00 00 00 02 3B FB
				15 01 00 00 00 00 02 3D 01
				15 01 00 00 00 00 02 3F 0B
				15 01 00 00 00 00 02 40 01
				15 01 00 00 00 00 02 41 1A
				15 01 00 00 00 00 02 42 01
				15 01 00 00 00 00 02 43 27
				15 01 00 00 00 00 02 44 01
				15 01 00 00 00 00 02 45 33
				15 01 00 00 00 00 02 46 01
				15 01 00 00 00 00 02 47 5D
				15 01 00 00 00 00 02 48 01
				15 01 00 00 00 00 02 49 7E
				15 01 00 00 00 00 02 4A 01
				15 01 00 00 00 00 02 4B B2
				15 01 00 00 00 00 02 4C 01
				15 01 00 00 00 00 02 4D DA
				15 01 00 00 00 00 02 4E 02
				15 01 00 00 00 00 02 4F 1B
				15 01 00 00 00 00 02 50 02
				15 01 00 00 00 00 02 51 4D
				15 01 00 00 00 00 02 52 02
				15 01 00 00 00 00 02 53 4F
				15 01 00 00 00 00 02 54 02
				15 01 00 00 00 00 02 55 81
				15 01 00 00 00 00 02 56 02
				15 01 00 00 00 00 02 58 B9
				15 01 00 00 00 00 02 59 02
				15 01 00 00 00 00 02 5A DF
				15 01 00 00 00 00 02 5B 03
				15 01 00 00 00 00 02 5C 11
				15 01 00 00 00 00 02 5D 03
				15 01 00 00 00 00 02 5E 2F
				15 01 00 00 00 00 02 5F 03
				15 01 00 00 00 00 02 60 56
				15 01 00 00 00 00 02 61 03
				15 01 00 00 00 00 02 62 62
				15 01 00 00 00 00 02 63 03
				15 01 00 00 00 00 02 64 6F
				15 01 00 00 00 00 02 65 03
				15 01 00 00 00 00 02 66 7E
				15 01 00 00 00 00 02 67 03
				15 01 00 00 00 00 02 68 90
				15 01 00 00 00 00 02 69 03
				15 01 00 00 00 00 02 6A A4
				15 01 00 00 00 00 02 6B 03
				15 01 00 00 00 00 02 6C BB
				15 01 00 00 00 00 02 6D 03
				15 01 00 00 00 00 02 6E CA
				15 01 00 00 00 00 02 6F 03
				15 01 00 00 00 00 02 70 FF
				15 01 00 00 00 00 02 71 00
				15 01 00 00 00 00 02 72 00
				15 01 00 00 00 00 02 73 00
				15 01 00 00 00 00 02 74 38
				15 01 00 00 00 00 02 75 00
				15 01 00 00 00 00 02 76 68
				15 01 00 00 00 00 02 77 00
				15 01 00 00 00 00 02 78 90
				15 01 00 00 00 00 02 79 00
				15 01 00 00 00 00 02 7A AE
				15 01 00 00 00 00 02 7B 00
				15 01 00 00 00 00 02 7C C7
				15 01 00 00 00 00 02 7D 00
				15 01 00 00 00 00 02 7E DF
				15 01 00 00 00 00 02 7F 00
				15 01 00 00 00 00 02 80 F0
				15 01 00 00 00 00 02 81 01
				15 01 00 00 00 00 02 82 03
				15 01 00 00 00 00 02 83 01
				15 01 00 00 00 00 02 84 3A
				15 01 00 00 00 00 02 85 01
				15 01 00 00 00 00 02 86 63
				15 01 00 00 00 00 02 87 01
				15 01 00 00 00 00 02 88 A2
				15 01 00 00 00 00 02 89 01
				15 01 00 00 00 00 02 8A CD
				15 01 00 00 00 00 02 8B 02
				15 01 00 00 00 00 02 8C 12
				15 01 00 00 00 00 02 8D 02
				15 01 00 00 00 00 02 8E 45
				15 01 00 00 00 00 02 8F 02
				15 01 00 00 00 00 02 90 47
				15 01 00 00 00 00 02 91 02
				15 01 00 00 00 00 02 92 7A
				15 01 00 00 00 00 02 93 02
				15 01 00 00 00 00 02 94 B4
				15 01 00 00 00 00 02 95 02
				15 01 00 00 00 00 02 96 DA
				15 01 00 00 00 00 02 97 03
				15 01 00 00 00 00 02 98 0E
				15 01 00 00 00 00 02 99 03
				15 01 00 00 00 00 02 9A 2C
				15 01 00 00 00 00 02 9B 03
				15 01 00 00 00 00 02 9C 55
				15 01 00 00 00 00 02 9D 03
				15 01 00 00 00 00 02 9E 61
				15 01 00 00 00 00 02 9F 03
				15 01 00 00 00 00 02 A0 6F
				15 01 00 00 00 00 02 A2 03
				15 01 00 00 00 00 02 A3 7F
				15 01 00 00 00 00 02 A4 03
				15 01 00 00 00 00 02 A5 93
				15 01 00 00 00 00 02 A6 03
				15 01 00 00 00 00 02 A7 A5
				15 01 00 00 00 00 02 A9 03
				15 01 00 00 00 00 02 AA BA
				15 01 00 00 00 00 02 AB 03
				15 01 00 00 00 00 02 AC C9
				15 01 00 00 00 00 02 AD 03
				15 01 00 00 00 00 02 AE FF
				15 01 00 00 00 00 02 AF 00
				15 01 00 00 00 00 02 B0 00
				15 01 00 00 00 00 02 B1 00
				15 01 00 00 00 00 02 B2 38
				15 01 00 00 00 00 02 B3 00
				15 01 00 00 00 00 02 B4 68
				15 01 00 00 00 00 02 B5 00
				15 01 00 00 00 00 02 B6 90
				15 01 00 00 00 00 02 B7 00
				15 01 00 00 00 00 02 B8 AE
				15 01 00 00 00 00 02 B9 00
				15 01 00 00 00 00 02 BA C7
				15 01 00 00 00 00 02 BB 00
				15 01 00 00 00 00 02 BC DF
				15 01 00 00 00 00 02 BD 00
				15 01 00 00 00 00 02 BE F0
				15 01 00 00 00 00 02 BF 01
				15 01 00 00 00 00 02 C0 03
				15 01 00 00 00 00 02 C1 01
				15 01 00 00 00 00 02 C2 3A
				15 01 00 00 00 00 02 C3 01
				15 01 00 00 00 00 02 C4 63
				15 01 00 00 00 00 02 C5 01
				15 01 00 00 00 00 02 C6 A2
				15 01 00 00 00 00 02 C7 01
				15 01 00 00 00 00 02 C8 CD
				15 01 00 00 00 00 02 C9 02
				15 01 00 00 00 00 02 CA 12
				15 01 00 00 00 00 02 CB 02
				15 01 00 00 00 00 02 CC 45
				15 01 00 00 00 00 02 CD 02
				15 01 00 00 00 00 02 CE 47
				15 01 00 00 00 00 02 CF 02
				15 01 00 00 00 00 02 D0 7A
				15 01 00 00 00 00 02 D1 02
				15 01 00 00 00 00 02 D2 B4
				15 01 00 00 00 00 02 D3 02
				15 01 00 00 00 00 02 D4 DA
				15 01 00 00 00 00 02 D5 03
				15 01 00 00 00 00 02 D6 0E
				15 01 00 00 00 00 02 D7 03
				15 01 00 00 00 00 02 D8 2C
				15 01 00 00 00 00 02 D9 03
				15 01 00 00 00 00 02 DA 55
				15 01 00 00 00 00 02 DB 03
				15 01 00 00 00 00 02 DC 61
				15 01 00 00 00 00 02 DD 03
				15 01 00 00 00 00 02 DE 6F
				15 01 00 00 00 00 02 DF 03
				15 01 00 00 00 00 02 E0 7F
				15 01 00 00 00 00 02 E1 03
				15 01 00 00 00 00 02 E2 93
				15 01 00 00 00 00 02 E3 03
				15 01 00 00 00 00 02 E4 A5
				15 01 00 00 00 00 02 E5 03
				15 01 00 00 00 00 02 E6 BA
				15 01 00 00 00 00 02 E7 03
				15 01 00 00 00 00 02 E8 C9
				15 01 00 00 00 00 02 E9 03
				15 01 00 00 00 00 02 EA FF
				15 01 00 00 00 00 02 ff 26
				15 01 00 00 00 00 02 fb 01
				15 01 00 00 00 00 02 03 18
				15 01 00 00 00 00 02 ff e0
				15 01 00 00 00 00 02 fb 01
				15 01 00 00 00 00 02 24 ca
				15 01 00 00 00 00 02 ff 23
				15 01 00 00 00 00 02 fb 01
				15 01 00 00 00 00 02 00 00
				15 01 00 00 00 00 02 01 84
				15 01 00 00 00 00 02 05 2d
				15 01 00 00 00 00 02 06 00
				15 01 00 00 00 00 02 ff 27
				15 01 00 00 00 00 02 1e 55
				15 01 00 00 00 00 02 fb 01
				15 01 00 00 00 00 02 ff 24
				15 01 00 00 00 00 02 9d 34
				15 01 00 00 00 00 02 fb 01
				15 01 00 00 00 00 02 ff 20
				15 01 00 00 00 00 02 1f ff
				15 01 00 00 00 00 02 fb 01
				15 01 00 00 00 00 02 ff 10
				15 01 00 00 00 00 02 35 01
				15 01 00 00 00 00 02 51 ff
				15 01 00 00 00 00 02 53 24
				15 01 00 00 00 00 02 55 00
				15 01 00 00 00 00 02 b0 00
				05 01 00 00 50 00 01 11
				05 01 00 00 00 00 01 29];
		qcom,mdss-dsi-off-command = [
				05 01 00 00 14 00 01 28
				05 01 00 00 78 00 01 10];

				
		nubia,mdss-dsi-cabc-command-off = [
			15 01 00 00 00 00 02 53 2c
			15 01 00 00 00 00 02 55 00
			];
		nubia,mdss-dsi-cabc-command-lever1 = [
			15 01 00 00 00 00 02 53 2c
			15 01 00 00 00 00 02 55 01
			];
		nubia,mdss-dsi-cabc-command-lever2 = [
			15 01 00 00 00 00 02 53 2c
			15 01 00 00 00 00 02 55 02
		];
		nubia,mdss-dsi-cabc-command-lever3 = [
			15 01 00 00 00 00 02 53 2c
			15 01 00 00 00 00 02 55 03
		];


		nubia,mdss-dsi-cabc-command-state = "dsi_lp_mode";
		qcom,mdss-dsi-on-command-state = "dsi_lp_mode";
		qcom,mdss-dsi-off-command-state = "dsi_hs_mode";
		nubia,mdss-dsi-panel-backlight-curve = <
					0x00 0x19 0x19 0x19 0x19 0x1A 0x1A 0x1A 0x1A 0x1A
					0x1B 0x1C 0x1d 0x1e 0x1f 0x20 0x21 0x22 0x23 0x24
					0x25 0x27 0x29 0x2B 0x2D 0x30 0x32 0x34 0x36 0x38
					0x3A 0x3D 0x40 0x43 0x46 0x49 0x4C 0x4F 0x52 0x55
					0x58 0x5C 0x60 0x64 0x68 0x6C 0x70 0x74 0x78 0x7C
					0x80 0x85 0x8A 0x90 0x95 0x9A 0x9F 0xA4 0xAA 0xAF
					0xB4 0xBB 0xC1 0xC8 0xCE 0xD5 0xDB 0xE2 0xE8 0xEF
					0xF5 0xFC 0x103 0x10A 0x111 0x118 0x11E 0x125 0x12C 0x133
					0x13A 0x142 0x14B 0x153 0x15C 0x164 0x16C 0x175 0x17D 0x186
					0x18E 0x198 0x1A1 0x1AB 0x1B4 0x1BE 0x1C8 0x1D1 0x1DB 0x1E4
					0x1EE 0x1F9 0x203 0x20E 0x219 0x224 0x22E 0x239 0x244 0x24E
					0x259 0x265 0x271 0x27D 0x289 0x296 0x2A2 0x2AE 0x2BA 0x2C6
					0x2D2 0x2DF 0x2ED 0x2FA 0x308 0x315 0x322 0x330 0x33D 0x34B
					0x358 0x367 0x375 0x384 0x393 0x3A2 0x3B0 0x3BF 0x3CE 0x3DC
					0x3EB 0x3FB 0x40B 0x41B 0x42B 0x43C 0x44C 0x45C 0x46C 0x47C
					0x48C 0x49D 0x4AF 0x4C0 0x4D2 0x4E3 0x4F4 0x506 0x517 0x529
					0x53A 0x54D 0x560 0x573 0x586 0x599 0x5AC 0x5BF 0x5D2 0x5E5
					0x5F8 0x60D 0x622 0x636 0x64B 0x660 0x675 0x68A 0x69E 0x6B3
					0x6C8 0x6DE 0x6F4 0x70B 0x721 0x737 0x74D 0x763 0x77A 0x790
					0x7A6 0x7BE 0x7D5 0x7ED 0x805 0x81D 0x834 0x84C 0x864 0x87B
					0x893 0x8AC 0x8C5 0x8DE 0x8F7 0x910 0x929 0x942 0x95B 0x974
					0x98D 0x9A8 0x9C3 0x9DF 0x9FA 0xA15 0xA30 0xA4B 0xA67 0xA82
					0xA9D 0xAB9 0xAD6 0xAF2 0xB0E 0xB2B 0xB47 0xB63 0xB7F 0xB9C
					0xBB8 0xBD6 0xBF4 0xC13 0xC31 0xC4F 0xC6D 0xC8B 0xCAA 0xCC8
					0xCE6 0xD06 0xD26 0xD46 0xD66 0xD86 0xDA6 0xDC6 0xDE6 0xE06
					0xE26 0xE47 0xE69 0xE8A 0xEAC 0xECD>;
		qcom,mdss-dsi-h-sync-pulse = <0>;
		qcom,mdss-dsi-traffic-mode = "non_burst_sync_event";
		qcom,mdss-dsi-bllp-eof-power-mode;
		qcom,mdss-dsi-bllp-power-mode;
		qcom,mdss-dsi-lp11-init;
		qcom,mdss-dsi-init-delay-us = <30000>;
		qcom,mdss-dsi-lane-0-state;
		qcom,mdss-dsi-lane-1-state;
		qcom,mdss-dsi-lane-2-state;
		qcom,mdss-dsi-lane-3-state;
		qcom,mdss-dsi-panel-timings = [00 1A 06 06 0A 10 05 06 05 03 04 00];
		qcom,mdss-dsi-t-clk-post = <0x07>;
		qcom,mdss-dsi-t-clk-pre = <0x29>;
		qcom,mdss-brightness-max-level = <4095>;
		qcom,mdss-brightness-min-level = <2>;
		qcom,mdss-dsi-bl-min-level = <2>;
		qcom,mdss-dsi-bl-max-level = <4095>;
		qcom,mdss-dsi-dma-trigger = "trigger_sw";
		qcom,mdss-dsi-mdp-trigger = "none";
		qcom,mdss-dsi-bl-pmic-control-type = "bl_ctrl_wled";
		qcom,mdss-dsi-bl-pmic-control-reg  = <0x51>;
		qcom,mdss-dsi-reset-sequence = <1 5>, <0 10>, <1 10>;

	};
};
